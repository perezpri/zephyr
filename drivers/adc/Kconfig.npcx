## drivers/adc/Kconfig.npcx
```kconfig
# NPCX ADC driver configuration options

# Copyright (c) 2020 Nuvoton Technology Corporation.
# SPDX-License-Identifier: Apache-2.0

config ADC_NPCX
	bool "Nuvoton NPCX embedded controller (EC) ADC driver"
	depends on SOC_FAMILY_NPCX
	help
	  This option enables the ADC driver for NPCX family of
	  processors.
	  Say y if you wish to use ADC channels on NPCX MCU.

if ADC_NPCX

menuconfig ADC_CMP_NPCX
	bool "Nuvoton NPCX ADC threshold detection interruption"
	default n
	help
	  This option enables threshold interruption using sensor
	  trigger API.

endif # ADC_NPCX
```

## drivers/input/Kconfig.gpio_irqs
```kconfig
# Copyright 2024 Google LLC
# SPDX-License-Identifier: Apache-2.0

config INPUT_GPIO_IRQS
	bool "GPIO IRQ input driver"
	default y
	depends on DT_HAS_GPIO_IRQS_ENABLED
	select GPIO
	help
	  Enable support for the GPIO IRQ driver. This driver
	  allows GPIO pins to be configured as interrupt sources with optional
	  debounce support and callback registration.

if INPUT_GPIO_IRQS

config INPUT_GPIO_IRQS_INIT_PRIORITY
	int "GPIO IRQ driver init priority"
	default 100
	help
	  Initialization priority for the gpio-irqs driver instances.

endif # INPUT_GPIO_IRQS
```

## dts/bindings/adc/adc-comparator.yaml
```yaml
# Copyright (c) 2022 Intel Corporation
# SPDX-License-Identifier: Apache-2.0

description: |
    Comparator will monitor signal though ADC and based on configuration,
    it will trigger a callback to user to inform signal criterion is met.

    User is responsible for configuring comparator to establish threshold assert
    value, comparison (less or equal, grater...) and callback handler.

compatible: "adc-comparator"

include: base.yaml

properties:
    io-channels:
      type: phandle-array
      required: true
      description: |
        ADC channel that will perform measurement.

    threshold:
      type: int
      required: true
      description: |
        Raw value present on ADC as threshold assert.

    comparison:
      type: string
      required: true
      description: |
        Determines relation between measured value and assertion threshold.

    period:
      type: int
      required: false
      description: |
        Signal sampling period in milliseconds.
```

## dts/bindings/adc/nuvoton,adc-cmp.yaml
```yaml
# Copyright (c) 2021 Intel Corporation
# SPDX-License-Identifier: Apache-2.0

description: |
    This will perform signal comparision with threshold established.

compatible: "nuvoton,adc-cmp"

include : adc-comparator.yaml
```

## dts/bindings/input/gpio-irqs.yaml
```yaml
# Copyright 2024 Google LLC
# Use of this source code is governed by a BSD-style license that can be
# found in the LICENSE file.

description: |
  GPIO IRQ bindings.

  After defining the devicetree nodes, register callbacks in C using the
  GPIO_IRQS_CALLBACK_DEFINE macro. The first argument is the device
  reference, the second is the handler function, and the third is an
  optional user data pointer.

  Devicetree example:

    #include <zephyr/dt-bindings/gpio/gpio.h>

    / {
            gpio_irqs {
                    compatible = "gpio-irqs";

                    sensor_drdy: sensor-data-ready {
                            gpios = <&gpio0 5 GPIO_ACTIVE_HIGH>;
                            flags = <(GPIO_INT_EDGE_RISING)>;
                            debounce-ms = <5>;
                            enable-on-init;
                            fire-on-init;
                    };

                    fault_line: fault-line {
                            gpios = <&gpio0 6 (GPIO_PULL_UP | GPIO_ACTIVE_LOW)>;
                            flags = <(GPIO_INT_EDGE_FALLING)>;
                    };
            };
    };

  C usage example:

    #include <zephyr/drivers/gpio_irqs.h>

    static void sensor_drdy_handler(const struct device *dev, void *user_data)
    {
            /* Handle sensor data-ready event */
    }

    static void fault_line_handler(const struct device *dev, void *user_data)
    {
            /* Handle fault line event */
    }

    GPIO_IRQS_CALLBACK_DEFINE(DEVICE_DT_GET(DT_NODELABEL(sensor_drdy)),
                              sensor_drdy_handler, NULL);

    GPIO_IRQS_CALLBACK_DEFINE(DEVICE_DT_GET(DT_NODELABEL(fault_line)),
                              fault_line_handler, NULL);

compatible: "gpio-irqs"

child-binding:
  description: GPIO IRQ definition.

  properties:
    gpios:
      type: phandle-array
      required: true
      description: |
        GPIO that will detect interruption.

    flags:
      type: int
      description: The zephyr gpio interrupt config flags.

    debounce-ms:
      type: int
      default: 0
      description: |
        Debounce time in milliseconds.

    enable-on-init:
      type: boolean
      description: |
        Defines if this irq is enabled once initialized.

    fire-on-init:
      type: boolean
      description: |
        Defines if this irq is fired one time after it has been initialized.
```

## subsys/ap_pwrseq/Kconfig
```kconfig
# Copyright 2023 Intel Corporation
# SPDX-License-Identifier: Apache-2.0

menuconfig AP_PWRSEQ
	bool "AP Power sequencing support"
	default y
	help
	  Enables AP power sequencing support with
	  embedded controller. This includes normal shutdown, critical
	  shutdown and reset handling.
	  Enabling this automatically enables HAS_TASK_POWERBTN since this task
	  is required to handle power button pressed/released by user.
	  Enabling this also enables retrieving the GPIO config feature
	  so that the value of output GPIOs can be determined.

if AP_PWRSEQ

module = AP_PWRSEQ
module-str = AP power sequencing
source "subsys/logging/Kconfig.template.log_config"

config AP_PWRSEQ_DRIVER
	bool "AP Power sequencing driver support"
	select SMF
	select SMF_ANCESTOR_SUPPORT
	select EVENTS
	help
	  AP power sequence driver establishes an underlaying framework to
	  easily add or extend AP Power Sequence action handler routines, it is
	  designed to follow the zephyr's State Machine Framework (SMF).

config AP_PWRSEQ_STACK_SIZE
	int "AP pwrseq stack size (in bytes)"
	default 1024
	help
	  This option specifies the size of the stack used by the
	  AP power sequencing state machine thread handler.
	  This must be set in a board configuration. If a default
	  is set here, it cannot be overridden (if necessary), since
	  this Kconfig appears before the EC chip specific stack
	  sizes.

config AP_PWRSEQ_THREAD_PRIORITY
	int "AP pwrseq thread priority"
	default 12
	help
	  This option determines AP power sequence thread priority, this number
	  must be selected in such way thread priority is in the middle of all
	  the enabled threads.
endif
```
